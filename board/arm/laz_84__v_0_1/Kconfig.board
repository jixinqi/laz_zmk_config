## board/arm/laz_84__v_0_1/Kconfig.board
```kconfig
# STM32F103RCT6 Laz Core Board configuration

# Copyright (c) 2020 WuhanStudio
# SPDX-License-Identifier: Apache-2.0

# http://www.keyboard-layout-editor.com/#/
# Layout is Keycool_84

config BOARD_LAZ_84_KEYBOARD
	bool "Laz 84 Keyboard"
	depends on SOC_STM32F103X8
```

## board/arm/laz_84__v_0_1/Kconfig.defconfig
```kconfig
# STM32F103RCT6 Laz Core Board configuration

# Copyright (c) 2020 WuhanStudio
# SPDX-License-Identifier: Apache-2.0

if BOARD_LAZ_84_KEYBOARD

config ZMK_KEYBOARD_NAME
	default "Laz84"

config ZMK_USB
    default y

config ZMK_KSCAN_MATRIX_POLLING
    default y

endif # BOARD_LAZ_84_KEYBOARD
```

## board/arm/laz_84__v_0_1/laz_84__v_0_1_defconfig
```kconfig
# SPDX-License-Identifier: Apache-2.0

# SoC
CONFIG_SOC_SERIES_STM32F1X=y
CONFIG_SOC_STM32F103X8=y

# 72MHz system clock
CONFIG_SYS_CLOCK_HW_CYCLES_PER_SEC=72000000

# enable pinmux
CONFIG_PINMUX=y
CONFIG_PINCTRL=y

# enable GPIO
CONFIG_GPIO=y

# enable clocks
CONFIG_CLOCK_CONTROL=y

# USB
CONFIG_USB_DEVICE_MANUFACTURER="Laz"
CONFIG_USB_DEVICE_PRODUCT="Laz84_Keyboard"
```

## board/arm/stm32f103c8t6_laz_core/Kconfig.board
```kconfig
# STM32F103RCT6 Laz Core Board configuration

# Copyright (c) 2020 WuhanStudio
# SPDX-License-Identifier: Apache-2.0

config BOARD_STM32F103C8T6_LAZ_CORE
	bool "STM32F103C8T6 laz core board"
	depends on SOC_STM32F103X8
```

## board/arm/stm32f103c8t6_laz_core/Kconfig.defconfig
```kconfig
# STM32F103RCT6 Laz Core Board configuration

# Copyright (c) 2020 WuhanStudio
# SPDX-License-Identifier: Apache-2.0

if BOARD_STM32F103C8T6_LAZ_CORE

config BOARD
	default "STM32F103C8T6_laz_core_board"

endif # BOARD_STM32F103C8T6_LAZ_CORE
```
